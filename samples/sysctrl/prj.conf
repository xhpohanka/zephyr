## CMakeLists.txt
```
#
# Copyright (c) 2020 Nordic Semiconductor
#
# SPDX-License-Identifier: LicenseRef-BSD-5-Clause-Nordic
#

cmake_minimum_required(VERSION 3.8.2)

include($ENV{ZEPHYR_BASE}/cmake/app/boilerplate.cmake NO_POLICY_SCOPE)
project("SYSCTRL application")

# Include application event headers
zephyr_library_include_directories(src/events)
zephyr_library_include_directories(src/modules/messaging)
zephyr_library_include_directories(src/modules/pot)
zephyr_library_include_directories(src/modules/tmr_srv_int)
zephyr_library_include_directories(src/modules/tmr_srv_ext)

# Application sources
# NORDIC SDK APP START
target_sources(app PRIVATE src/main.c)

target_sources(app PRIVATE
		src/events/status_event.c
		src/events/led_event.c
		src/events/sleep_event.c
		src/events/performance_event.c
		src/events/prism_event.c
		src/events/ld_notify_event.c
		src/events/tmr_srv_ext_event.c
)

target_sources(app PRIVATE
		src/modules/dummy/leds.c
		src/modules/power_management/power_control.c
		src/modules/messaging/filter.c
		src/modules/messaging/prism_dispatcher.c
		src/modules/messaging/ncm.c
		src/modules/pot/pot.c
		src/modules/pot/tmr_mngr.c
		src/modules/pot/tmr_mngr_backend_nrf52.c
		src/modules/tmr_srv_int/tmr_srv_int.c
		src/modules/tmr_srv_ext/tmr_srv_ext.c
)

# NORDIC SDK APP END
```

## prj.conf
```kconfig
#
# Copyright (c) 2019 Nordic Semiconductor ASA
#
# SPDX-License-Identifier: LicenseRef-BSD-5-Clause-Nordic
#
# Enabling assert
CONFIG_ASSERT=y
CONFIG_NRFX_RTC2=y

# Logger configuration
CONFIG_LOG=y
CONFIG_LOG_DEFAULT_LEVEL=2
CONFIG_LOG_BACKEND_UART=y
CONFIG_LOG_STRDUP_BUF_COUNT=10

# Configuration required by Event Manager
CONFIG_EVENT_MANAGER=y
CONFIG_LINKER_ORPHAN_SECTION_PLACE=y
CONFIG_HEAP_MEM_POOL_SIZE=2048
CONFIG_REBOOT=y

# Configuration required by Prism Dispatcher
CONFIG_IPM=y
CONFIG_IPM_NRFX=y
CONFIG_IPM_MSG_CH_0_ENABLE=y
CONFIG_IPM_MSG_CH_1_ENABLE=y
CONFIG_IPM_MSG_CH_0_TX=y
CONFIG_IPM_MSG_CH_1_RX=y

CONFIG_PRISM_DISPATCHER=y
CONFIG_PRISM_DISPATCHER_ALGO_SINGLEBUF=y
CONFIG_PRISM_DISPATCHER_BACKEND_OPENAMP=y
CONFIG_PRISM_DISPATCHER_APP_ENABLED=y
CONFIG_PRISM_DISPATCHER_EPT_COUNT=4
CONFIG_PRISM_DISPATCHER_MSG_SIZE=128

CONFIG_RPMSG_MASTER=y

CONFIG_TEST_RANDOM_GENERATOR=y

CONFIG_PM_ENABLE=y

CONFIG_NRFS=y
```

## src/main.c
```c
/*
 * Copyright (c) 2020 Nordic Semiconductor ASA
 *
 * SPDX-License-Identifier: LicenseRef-BSD-5-Clause-Nordic
 */

#include <zephyr.h>

/*$$$LICENCE_NORDIC_STANDARD<2018>$$$*/

/**
 * @defgroup empty_example_main Empty application
 * @{
 * @ingroup nrfx_examples
 *
 * @brief Empty example Application main file.
 *
 * This file contains the source code for a sample application with logger subsystem.
 *
 * Please connect development kit and configure following options when opening COM port:
 *  - Baudrate:   115200
 *  - Parity:     None
 *  - Stop bits:  1
 *  - Data bits:  8
 *
 * @}
 */
#include <stdlib.h>
#include <stdint.h>

#include <logging/log.h>
#include <event_manager.h>
#include <status_event.h>

LOG_MODULE_REGISTER(MAIN, LOG_LEVEL_INF);

/**
 * @brief Function for application main entry.
 */
int main(void)
{
	LOG_ERR("Start");
	if (event_manager_init()) {
		LOG_ERR("Event Manager not initialized");
	} else {
		struct status_event *event = new_status_event();
		event->status = STATUS_INIT;
		EVENT_SUBMIT(event);
	}

	return 0;
}
```
